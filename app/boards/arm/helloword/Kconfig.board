## app/boards/arm/helloword/Kconfig.board
```kconfig
# HelloWord board configuration

# Copyright (c) 2022 The ZMK Contributors
# SPDX-License-Identifier: MIT

config BOARD_HELLOWORD
	bool "HelloWord"
	depends on SOC_STM32F103XB
```

## app/boards/arm/helloword/Kconfig.defconfig
```kconfig
# HelloWord board configuration

# Copyright (c) 2022 The ZMK Contributors
# SPDX-License-Identifier: MIT

if BOARD_HELLOWORD

config BOARD
	default "helloword"

config ZMK_KEYBOARD_NAME
	default "HelloWord"

config ZMK_USB
	default y

endif # BOARD_HELLOWORD
```
